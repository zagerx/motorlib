## Kconfig
```kconfig
#// clang-format off


config MOTORLIB_ENABLE
    bool "Enable motor library"
    default n  # 默认禁用
    help
      Enable motor control library

if MOTORLIB_ENABLE         
	config CMSIS_DSP
		bool
		default y
	config CMSIS_DSP_BASICMATH
		bool
		default y
	config CMSIS_DSP_CONTROLLER
		bool
		default y
	config CMSIS_DSP_FASTMATH
		bool
		default y
	config COMMONLIBRARY_ENABLE
		bool
		default y
endif # MOTORLIB_ENABLE      
      
      
rsource "drivers/Kconfig.drivers"
rsource "lib/Kconfig"


#// clang-format on
```

## Kconfig.motorlib
```kconfig
rsource "drivers/Kconfig.drivers" 
config MOTOR_LIB_LOG_LEVEL
	int "Motor lib log level"
	default 1
	range 0 4
	help
	  Set log level for motor lib.
```

## drivers/Kconfig.drivers
```kconfig
rsource "currsmp/Kconfig.currsmp" 
rsource "feedback/Kconfig.feedback" 
rsource "pwm/Kconfig.pwm" 
```

## drivers/currsmp/Kconfig.currsmp
```kconfig
config CURRSMP_SHUNT_LOG_LEVEL
	int "Shunt Current Sampling log level"
	default 1
	range 0 4
	help
	  Set log level for shunt current sampling driver.

config CURRSMP_INIT_PRIORITY
        int "Current sampling initialization priority"
        range 0 95
        default 95
        help
          Initialization priority for current sampling devices.
          Must initialize before FOC algorithms.


config USER_USE_STM32_HAL_ADC
	bool "stm32 hal adc"
	select USE_STM32_HAL_ADC_EX
	select USE_STM32_HAL_ADC
	select USE_STM32_HAL_GPIO_EX
	select USE_STM32_HAL_GPIO
	select USE_STM32_HAL_OPAMP
	select USE_STM32_HAL_OPAMP_EX
	help
	   Temp Start STM32 HAL Lib 
```

## drivers/feedback/Kconfig.feedback
```kconfig
config FEEDBACK_LOG_LEVEL
	int "Feedback log level"
	default 1
	range 0 4
	help
	  Set log level for feedback driver.

config FEEDBACK_INIT_PRIORITY
        int "Feedback sensor initialization priority"
        range 0 97  
        default 97
        help
          Initialization priority for motor feedback sensors (encoders/hall).
          Must initialize before FOC/motor control.

config MOTOR_SUPER_ABZHALL_400W
	bool "SPUER_400 (400W brushless)"
	depends on MOTORLIB_ENABLE      
	default y if MOTORLIB_ENABLE   
	help
	  400W brushless motor with encoder
	  
config ENCODER_TYPE_AS5047
    bool "Encoder type"
    default n  # 默认禁用
    help
      Enable motor control library

config ENCODER_TYPE_TLE5012B
	bool "Encoder type"
	default n  # 默认禁用
	depends on SPI
	help
	  Enable motor control library      

config USER_USE_STM32_HAL_SPI
	bool "stm32 hal gpio"
	select USE_STM32_HAL_SPI_EX
	select USE_STM32_HAL_SPI
	select USE_STM32_HAL_GPIO_EX
	select USE_STM32_HAL_GPIO
	help
	   Temp Start STM32 HAL Lib 
```

## drivers/feedback/ams_as5047/Kconfig.as5047
```kconfig
# AS5047 Angular position sensor configuration option

# Copyright (c) 2022, Felipe Neves.
# SPDX-License-Identifier: Apache-2.0

config AMS_AS5047
	bool "AS5047 Angular position sensor"
	default y
	depends on DT_HAS_AMS_AS5047_ENABLED
	select SPI
	help
	  Enable driver for AS5047 Angular position sensor.
```

## drivers/pwm/Kconfig.pwm
```kconfig
config PWM_LOG_LEVEL
	int "Pwm log level"
	default 1
	range 0 4
	help
	  Set log level for pwm driver.

config PWMX_STM32_INIT_PRIORITY
        int "PWM driver initialization priority"
        range 0 96
        default 96  
        help
          Initialization priority for STM32 PWM drivers.
          Must initialize before current sampling/FOC.

config USER_USE_STM32_HAL_TIM
	bool "stm32 hal adc"
	select USE_STM32_HAL_TIM_EX
	select USE_STM32_HAL_TIM
	select USE_STM32_HAL_GPIO_EX
	select USE_STM32_HAL_GPIO
	select USE_STM32_HAL_CORTEX
	help
	   Temp Start STM32 HAL Lib 	  
```

## lib/Kconfig
```kconfig
      
config MOTOR_LIB_LOG_LEVEL
	int "Motor lib log level"
	default 1
	range 0 4
	help
	  Set log level for motor lib.

config MOTOR_INIT_PRIORITY
	int "Motor control device initialization priority"
	range 0 99
	default 99
	help
	  Initialization priority for motor control devices (lower value = earlier init).
	  Must be higher than dependent devices (FOC/PWM/Feedback).

config FOC_INIT_PRIORITY
	int "FOC algorithm initialization priority" 
	range 0 98
	default 98
	help
	  Initialization priority for FOC control algorithms.
	  Must be higher than PWM/current sampling devices.


# 调试说明：
# MOTOR_DEBUG_MODE总开关,对电流环进行调试
# 新电机的调试顺序：
#	1、开启MOTOR_DEBUG_SELFLOOPMODE，电机自开环，校准编码器
#	2、开启MOTOR_DEBUG_ENCODERMODE，验证相电流
#	3、开启MOTOR_DEBUG_TORQUE_PID，调试电流环D轴PID
#	4、开启SPEEDLOOP_DEBUG，调试速度环PID
		# a.空载额定转速的0～50%～100%来进行调试
config MOTOR_DEBUG_MODE
	bool "Enable motor debug mode"
	default n
	help
	  Enable motor debug mode for testing purposes

choice
	prompt "Debug mode selection"
	depends on MOTOR_DEBUG_MODE
	default MOTOR_DEBUG_SELFLOOPMODE
	
config MOTOR_DEBUG_ENCODERMODE
	bool "Encoder debug mode"
	help
	  Use encoder angle for debugging
config MOTOR_DEBUG_TORQUE_PID
	bool "Self-loop debug mode"
	help
	  Use internal angle generator for debugging	
config MOTOR_DEBUG_SELFLOOPMODE
	bool "Self-loop debug mode"
	help
	  Use internal angle generator for debugging
endchoice

# 对速度环进行调试
# 请确保MOTOR_DEBUG_MODE为关闭状态
choice
	prompt "Speed-loop algorithm"
	default SPEEDLOOP_S_SPEEDPLAN

config SPEEDLOOP_S_SPEEDPLAN
	bool "S-curve speed planning"

config SPEEDLOOP_DEBUG
	bool "Debug speed mode (no S-planning)"
endchoice
```

## lib/bldcmotor/Kconfig.motor
```kconfig
choice
    prompt "Motor Type Selection"
    default MOTOR_SUPER_ABZHALL_400W
    help
      Select the motor type for this board

config MOTOR_SUPER_ABZHALL_400W
    bool "SPUER_400 (400W brushless)"
    help
      400W brushless motor with encoder

config MOTOR_BARO_ABZHALL_750W
    bool "M3508 (Compact brushless)"
    help
      Compact brushless motor with reducer

config MOTOR_ELUR_HALL
    bool "M2006 (Small brushless)"
    help
      Small brushless motor for lightweight applications
endchoice
```
